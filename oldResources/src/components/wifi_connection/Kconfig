## oldResources/src/components/wifi_connection/Kconfig
```kconfig
menu "Wi-Fi Connector Manager"
    choice
        prompt "WIFI connection type"
        default WIFI_CON_METHOD_WPA_ENT
        config WIFI_CON_METHOD_WPA
            bool "WPA"
        config WIFI_CON_METHOD_WPA_ENT
            bool "WPA_ENT"
        config WIFI_CON_EAP_METHOD_WPS
            bool "WPS"
    endchoice
 
    config ESP_WIFI_SSID
        string "WiFi SSID"
        default "myssid"
        help
            SSID (network name) for the WIFICON to connect to.
    
if WIFI_CON_METHOD_WPA
    config ESP_WIFI_PASSWORD
        string "WiFi Password"
        default "mypassword"
        help
            WiFi password (WPA or WPA2) for the WIFICON to use.
endif

if WIFI_CON_METHOD_WPA_ENT

    config WIFICON_VALIDATE_SERVER_CERT
        bool "Validate server"
        default n
        help
            Validate the servers' certificate using CA cert.
if WIFICON_VALIDATE_SERVER_CERT
    config WIFICON_VALIDATE_SERVER_CERT_NAME
        string "Validate server CA"
        default "wpa2_ca.pem"
        help
            Validate the servers via certificate using CA.
endif

    choice
        prompt "EAP method to use"
        default WIFICON_EAP_METHOD_PEAP
        config WIFICON_EAP_METHOD_TLS
            bool "TLS"
        config WIFICON_EAP_METHOD_PEAP
            bool "PEAP"
        config WIFICON_EAP_METHOD_TTLS
            bool "TTLS"
    endchoice

    config WIFICON_EAP_METHOD
        int
        default 0 if WIFICON_EAP_METHOD_TLS
        default 1 if WIFICON_EAP_METHOD_PEAP
        default 2 if WIFICON_EAP_METHOD_TTLS

    config WIFICON_EAP_ID
        string "EAP ID"
        default "WIFICON@espressif.com"
        help
            Identity in phase 1 of EAP procedure.

    config  WIFICON_EAP_METHOD_TLS_CERT_NAME
            string "EAP TLS CERTIFICATE"
        depends on WIFICON_EAP_METHOD_TLS
        default "wpa2_client.crt"
        help
            Certificate for EAP method (TLS).
    
    config  WIFICON_EAP_METHOD_TLS_KEY_NAME
            string "EAP TLS KEY"
        depends on WIFICON_EAP_METHOD_TLS
        default "wpa2_client.key"
        help
            Key for EAP method (TLS).     

    config WIFICON_EAP_USERNAME
        string "EAP USERNAME"
        depends on WIFICON_EAP_METHOD_PEAP || WIFICON_EAP_METHOD_TTLS
        default "espressif"
        help
            Username for EAP method (PEAP and TTLS).

    config WIFICON_EAP_PASSWORD
        string "EAP PASSWORD"
        depends on WIFICON_EAP_METHOD_PEAP || WIFICON_EAP_METHOD_TTLS
        default "test11"
        help
            Password for EAP method (PEAP and TTLS).
endif

if WIFI_CON_EAP_METHOD_WPS
    choice WIFICON_WPS_TYPE
        prompt "WPS mode"
        default WIFICON_WPS_TYPE_PBC
        help
            WPS type for the esp32 to use.

        config WIFICON_WPS_TYPE_PBC
            bool "PBC"
        config WIFICON_WPS_TYPE_PIN
            bool "PIN"
        config WIFICON_WPS_TYPE_DISABLE
            bool "disable"
    endchoice
endif	

config ESP_MAXIMUM_RETRY
    int "Maximum retry"
    default 5
    help
        Set the Maximum retry to avoid station reconnecting to the AP unlimited when the AP is really inexistent.

endmenu
```

## src/components/wifi_connection/Kconfig
```kconfig
menu "Wi-Fi Connector Manager"
    choice
        prompt "WIFI connection type"
        default WIFI_CON_METHOD_WPA_ENT
        config WIFI_CON_METHOD_WPA
            bool "WPA"
        config WIFI_CON_METHOD_WPA_ENT
            bool "WPA_ENT"
        config WIFI_CON_EAP_METHOD_WFS
            bool "WFS"
    endchoice

config EXAMPLE_WIFI_SSID
        string "WiFi SSID. FIX ME !!!!"
        default "wpa2_test"
        help
            SSID (network name) for the example to connect to.

    
if WIFI_CON_METHOD_WPA
    config ESP_WIFI_SSID
        string "WiFi SSID"
        default "myssid"
        help
            SSID (network name) for the example to connect to.

    config ESP_WIFI_PASSWORD
        string "WiFi Password"
        default "mypassword"
        help
            WiFi password (WPA or WPA2) for the example to use.
endif

if WIFI_CON_METHOD_WPA_ENT

    config EXAMPLE_VALIDATE_SERVER_CERT
        bool "Validate server"
        default n
        help
            Validate the servers' certificate using CA cert.

    choice
        prompt "EAP method for the example to use"
        default EXAMPLE_EAP_METHOD_PEAP
        config EXAMPLE_EAP_METHOD_TLS
            bool "TLS"
        config EXAMPLE_EAP_METHOD_PEAP
            bool "PEAP"
        config EXAMPLE_EAP_METHOD_TTLS
            bool "TTLS"
    endchoice

    config EXAMPLE_EAP_METHOD
        int
        default 0 if EXAMPLE_EAP_METHOD_TLS
        default 1 if EXAMPLE_EAP_METHOD_PEAP
        default 2 if EXAMPLE_EAP_METHOD_TTLS

    config EXAMPLE_EAP_ID
        string "EAP ID"
        default "example@espressif.com"
        help
            Identity in phase 1 of EAP procedure.

    config EXAMPLE_EAP_USERNAME
        string "EAP USERNAME"
        depends on EXAMPLE_EAP_METHOD_PEAP || EXAMPLE_EAP_METHOD_TTLS
        default "espressif"
        help
            Username for EAP method (PEAP and TTLS).

    config EXAMPLE_EAP_PASSWORD
        string "EAP PASSWORD"
        depends on EXAMPLE_EAP_METHOD_PEAP || EXAMPLE_EAP_METHOD_TTLS
        default "test11"
        help
            Password for EAP method (PEAP and TTLS).
endif

if WIFI_CON_EAP_METHOD_WFS
    choice EXAMPLE_WPS_TYPE
        prompt "WPS mode"
        default EXAMPLE_WPS_TYPE_PBC
        help
            WPS type for the esp32 to use.

        config EXAMPLE_WPS_TYPE_PBC
            bool "PBC"
        config EXAMPLE_WPS_TYPE_PIN
            bool "PIN"
        config EXAMPLE_WPS_TYPE_DISABLE
            bool "disable"
    endchoice
endif	

config ESP_MAXIMUM_RETRY
    int "Maximum retry"
    default 5
    help
        Set the Maximum retry to avoid station reconnecting to the AP unlimited when the AP is really inexistent.

endmenu
```

## tests/MqttWebsocketTest/components/wifi_connection/Kconfig
```kconfig
menu "Wi-Fi Connector Manager"
    config WIFI_CONNECTOR
    bool "Enable WIFI connector."
    help
        This enables the BAR feature of the FOO component.
endmenu
```

## tests/MqttWebsocketTest/main/Kconfig.projbuild
```kconfig
menu "MqttWebsocketTest Configuration"

    config EXAMPLE_WIFI_SSID
        string "WiFi SSID"
        default "wpa2_test"
        help
            SSID (network name) for the example to connect to.

    config EXAMPLE_VALIDATE_SERVER_CERT
        bool "Validate server"
        default y
        help
            Validate the servers' certificate using CA cert.

    choice
        prompt "EAP method for the example to use"
        default EXAMPLE_EAP_METHOD_PEAP
        config EXAMPLE_EAP_METHOD_TLS
            bool "TLS"
        config EXAMPLE_EAP_METHOD_PEAP
            bool "PEAP"
        config EXAMPLE_EAP_METHOD_TTLS
            bool "TTLS"
    endchoice

    config EXAMPLE_EAP_METHOD
        int
        default 0 if EXAMPLE_EAP_METHOD_TLS
        default 1 if EXAMPLE_EAP_METHOD_PEAP
        default 2 if EXAMPLE_EAP_METHOD_TTLS

    config EXAMPLE_EAP_ID
        string "EAP ID"
        default "example@espressif.com"
        help
            Identity in phase 1 of EAP procedure.

    config EXAMPLE_EAP_USERNAME
        string "EAP USERNAME"
        depends on EXAMPLE_EAP_METHOD_PEAP || EXAMPLE_EAP_METHOD_TTLS
        default "espressif"
        help
            Username for EAP method (PEAP and TTLS).

    config EXAMPLE_EAP_PASSWORD
        string "EAP PASSWORD"
        depends on EXAMPLE_EAP_METHOD_PEAP || EXAMPLE_EAP_METHOD_TTLS
        default "test11"
        help
            Password for EAP method (PEAP and TTLS).

    config BROKER_URI
        string "Broker URL"
        default "wss://mqtt.eclipse.org:443/mqtt"
        help
            URL of an mqtt broker which this example connects to.

    config BROKER_CERTIFICATE_OVERRIDE
        string "Server certificate override"
        default ""
        help
            Please leave empty if server certificate included from a textfile; otherwise fill in a base64 part of PEM
            format certificate

    config BROKER_CERTIFICATE_OVERRIDDEN
        bool
        default y if BROKER_CERTIFICATE_OVERRIDE != ""

endmenu
```
